## mt7628/build/Kconfig
```kconfig
config MT_AP_SUPPORT
	tristate "Ralink RT2860 802.11n AP support"
#	depends on NET_RADIO 
	select WIRELESS_EXT
	select WEXT_SPY
	select WEXT_PRIV

config WDS_SUPPORT
	bool "WDS"
	depends on MT_AP_SUPPORT

config MBSS_SUPPORT
	bool "MBSSID"
	depends on MT_AP_SUPPORT
	default y

config NEW_MBSSID_MODE
	bool "New MBSSID MODE"
	depends on MT_AP_SUPPORT && MBSS_SUPPORT
	depends on RALINK_RT3883 || RALINK_RT3352 || RALINK_RT5350 || RALINK_RT6352 || RALINK_MT7620
	default y

config ENHANCE_NEW_MBSSID_MODE
	bool "Enhanced MBSSID mode"
	depends on NEW_MBSSID_MODE
	default y

config APCLI_SUPPORT
	bool "AP-Client Support"
	depends on MT_AP_SUPPORT

config MAC_REPEATER_SUPPORT
	bool "MAC Repeater Support"
	depends on MT_AP_SUPPORT
	depends on APCLI_SUPPORT
	depends on RALINK_RT6352 || RALINK_MT7620 || RALINK_MT7603E || MT_AP_SUPPORT
	default n

#config DOT11R_FT_SUPPORT
#	bool "802.11r Fast BSS Transition"
#	depends on MT_AP_SUPPORT

#config DOT11K_RRM_SUPPORT
#	bool "802.11k Radio Resource Management"
#	depends on MT_AP_SUPPORT

config CON_WPS_SUPPORT
	bool "Concurrent WPS Support"
	depends on MT_AP_SUPPORT
	depends on APCLI_SUPPORT
	depends on WSC_INCLUDED
	depends on WSC_V2_SUPPORT
	default n
	
config LLTD_SUPPORT
	bool "LLTD (Link Layer Topology Discovery Protocol)"
	depends on MT_AP_SUPPORT

#config COC_SUPPORT
#	bool "CoC Support"
#	depends on MT_AP_SUPPORT
#	default n

#config  RT2860V2_SNMP
#	bool "Net-SNMP Support"
#	depends on MT_AP_SUPPORT

#config MCAST_RATE_SPECIFIC
#	bool "User specific tx rate of mcast pkt"
#	depends on MT_AP_SUPPORT

#config EXT_BUILD_CHANNEL_LIST
#	bool "Extension Channel List"
#	depends on MT_AP_SUPPORT

#config AUTO_CH_SELECT_ENHANCE
#	bool "Auto Channel Selection Enhancement"
#	depends on MT_AP_SUPPORT

config AIRPLAY_SUPPORT
	bool "AIRPLAY Support"
	depends on MT_AP_SUPPORT
	default n
```
